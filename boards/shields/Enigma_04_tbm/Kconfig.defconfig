## boards/shields/Enigma_04_tbm/Kconfig.defconfig
```kconfig
if SHIELD_Enigma_04_tbm
	
config ZMK_KEYBOARD_NAME
    default "Enigma_04_tbm"

config ZMK_USB
	default y

config ZMK_BLE
    default y

config NFCT_PINS_AS_GPIOS
    default y

endif
```

## boards/shields/Enigma_04_tbm/Kconfig.shield
```kconfig
config SHIELD_Enigma_04_tbm
    def_bool $(shields_list_contains,Enigma_04_tbm)

config SHIELD_Enigma_04_tbm_R
    def_bool $(shields_list_contains,Enigma_04_tbm_R)

config SHIELD_Enigma_04_tbm_L
    def_bool $(shields_list_contains,Enigma_04_tbm_L)

config SHIELD_Enigma_04_tbm_C
    def_bool $(shields_list_contains,Enigma_04_tbm_C)
```
